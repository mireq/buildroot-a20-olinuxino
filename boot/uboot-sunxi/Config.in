## boot/uboot-sunxi/Config.in
```kconfig
config BR2_TARGET_UBOOT_SUNXI
    depends on BR2_cortex_a7
    bool "U-Boot Sunxi"
    help
      Build "Das U-Boot" Boot Monitor for Allwinner A10 & A13

if BR2_TARGET_UBOOT_SUNXI
config BR2_TARGET_UBOOT_SUNXI_BOARDNAME
  string "U-Boot board name"
  help
    One of U-Boot supported boards to be built.
    This will be suffixed with _config to meet U-Boot standard naming.
    See boards.cfg in U-Boot source code for the list of available
    configurations.


config BR2_TARGET_UBOOT_SUNXI_GITHUB_LOCATION
  string "Link to github of U-Boot Sunxi"

config BR2_TARGET_UBOOT_SUNXI_GITHUB_TAG
  string "TAG of the particular commit"

config BR2_TARGET_UBOOT_SUNXI_CUSTOM_PATCH_DIR
  string "custom patch dir"
  help
    If your board requires custom patches, add the path to the
    directory containing the patches here. The patches must be
    named uboot-<version>-<something>.patch.

    Most users may leave this empty

choice
  prompt "U-Boot binary format"
  default BR2_TARGET_UBOOT_SUNXI_FORMAT_BIN

config BR2_TARGET_UBOOT_SUNXI_FORMAT_AIS
  bool "u-boot.ais"
  help
    AIS (Application Image Script) is a format defined by TI.
    It is required to load code/data on OMAP-L1 processors.
    u-boot.ais contains U-Boot with the SPL support.

config BR2_TARGET_UBOOT_SUNXI_FORMAT_BIN
  bool "u-boot.bin"

config BR2_TARGET_UBOOT_SUNXI_FORMAT_IMG
  bool "u-boot.img"

config BR2_TARGET_UBOOT_SUNXI_FORMAT_NAND_BIN
  bool "u-boot-nand.bin"

config BR2_TARGET_UBOOT_SUNXI_FORMAT_KWB
  depends on BR2_arm
  bool "u-boot.kwb (Marvell)"

config BR2_TARGET_UBOOT_SUNXI_FORMAT_LDR
  depends on BR2_bfin
  bool "u-boot.ldr"

endchoice

menuconfig BR2_TARGET_UBOOT_SUNXI_NETWORK
  bool "Custom Network Settings"
  help
    Custom network settings for U-boot

if BR2_TARGET_UBOOT_SUNXI_NETWORK

config BR2_TARGET_UBOOT_SUNXI_SERVERIP
  string "server ip"
  default "10.175.196.221"
  help
    TFTP server ip address

config BR2_TARGET_UBOOT_SUNXI_IPADDR
  string "ip address"
  default "10.175.196.18"
  help
    Target ip address

config BR2_TARGET_UBOOT_SUNXI_GATEWAY
  string "gateway ip"
  default "10.175.196.1"
  help
    Gateway ip address

config BR2_TARGET_UBOOT_SUNXI_NETMASK
  string "netmask"
  default "255.255.255.0"
  help
    Network Mask

config BR2_TARGET_UBOOT_SUNXI_ETHADDR
  string "ethernet address"
  default "04:25:fe:ed:00:18"
  help
    Target MAC address for the ethernet interface.
    This should be changed for production units

config BR2_TARGET_UBOOT_SUNXI_ETH1ADDR
  string "ethernet 2 address"
  help
    Target MAC address for the second ethernet interface.

endif # BR2_TARGET_UBOOT_SUNXI_NETWORK

config BR2_TARGET_UBOOT_SUNXI_SPL
  bool "U-Boot SPL support"
  depends on !BR2_TARGET_XLOADER
  help
    Enable the U-Boot SPL support. SPL is a first stage
    bootloader loaded into internal memory in charge of
    enabling and configuring the external memory (DDR),
    and load the u-boot program into DDR.

config BR2_TARGET_UBOOT_SUNXI_SPL_NAME
  string "U-Boot SPL target name"
  default "sunxi-spl.bin"
  depends on BR2_TARGET_UBOOT_SUNXI_SPL
  help
    This is the name of the SPL binary, generated during
    u-boot build. For most platform it is u-boot-spl.bin
    but not always. It is MLO on OMAP for example.

endif # BR2_TARGET_UBOOT_SUNXI
```

## configs/a13_olinuxino_defconfig
```kconfig
BR2_arm=y
BR2_cortex_a8=y
BR2_TOOLCHAIN_BUILDROOT_LARGEFILE=y
BR2_TOOLCHAIN_BUILDROOT_INET_IPV6=y
BR2_TOOLCHAIN_BUILDROOT_WCHAR=y
BR2_ROOTFS_POST_BUILD_SCRIPT="board/a13_olinuxino/post-build.sh"
BR2_ROOTFS_POST_IMAGE_SCRIPT="board/a13_olinuxino/post-image.sh"
BR2_PACKAGE_BUSYBOX_SHOW_OTHERS=y
BR2_PACKAGE_PICOLISP=y
BR2_PACKAGE_DHCP=y
BR2_PACKAGE_DHCP_SERVER=y
BR2_PACKAGE_DHCP_RELAY=y
BR2_PACKAGE_DHCP_CLIENT=y
BR2_PACKAGE_DROPBEAR=y
BR2_PACKAGE_WIRELESS_TOOLS=y
BR2_PACKAGE_WIRELESS_TOOLS_LIB=y
BR2_PACKAGE_WPA_SUPPLICANT=y
BR2_PACKAGE_WPA_SUPPLICANT_EAP=y
BR2_PACKAGE_WPA_SUPPLICANT_CLI=y
BR2_PACKAGE_WPA_SUPPLICANT_PASSPHRASE=y
BR2_PACKAGE_WPA_SUPPLICANT_AP_SUPPORT=y
BR2_PACKAGE_WPA_SUPPLICANT_WPS=y
BR2_PACKAGE_MODULE_INIT_TOOLS=y
BR2_PACKAGE_UEMACS=y
BR2_PACKAGE_A13_OLINUXINO_SOFTWARE=y
BR2_PACKAGE_A13_OLINUXINO_SOFTWARE_MOD_RTC=y
BR2_PACKAGE_A13_OLINUXINO_SOFTWARE_MOD_TC_MK2=y
BR2_TARGET_UBOOT_SUNXI=y
BR2_TARGET_UBOOT_SUNXI_BOARDNAME="A13-OLinuXino"
BR2_TARGET_UBOOT_SUNXI_GITHUB_LOCATION="https://github.com/linux-sunxi/u-boot-sunxi/archive/"
BR2_TARGET_UBOOT_SUNXI_GITHUB_TAG="v2013.04-sunxi"
BR2_TARGET_UBOOT_SUNXI_SPL=y
BR2_LINUX_KERNEL=y
BR2_LINUX_KERNEL_CUSTOM_GIT=y
BR2_LINUX_KERNEL_CUSTOM_GIT_REPO_URL="https://github.com/linux-sunxi/linux-sunxi.git"
BR2_LINUX_KERNEL_DEFCONFIG="a13"
BR2_LINUX_KERNEL_INSTALL_TARGET=y
```

## configs/a20_olinuxino_crossng_defconfig
```kconfig
BR2_arm=y
BR2_cortex_a7=y
BR2_TOOLCHAIN_BUILDROOT_LARGEFILE=y
BR2_TOOLCHAIN_BUILDROOT_INET_IPV6=y
BR2_TOOLCHAIN_BUILDROOT_WCHAR=y
BR2_ROOTFS_POST_BUILD_SCRIPT="board/a20_olinuxino/post-build.sh"
BR2_ROOTFS_POST_IMAGE_SCRIPT="board/a20_olinuxino/post-image.sh"
BR2_PACKAGE_BUSYBOX_SHOW_OTHERS=y
BR2_PACKAGE_DHCP=y
BR2_PACKAGE_DHCP_SERVER=y
BR2_PACKAGE_DHCP_RELAY=y
BR2_PACKAGE_DHCP_CLIENT=y
BR2_PACKAGE_DROPBEAR=y
BR2_PACKAGE_WIRELESS_TOOLS=y
BR2_PACKAGE_WIRELESS_TOOLS_LIB=y
BR2_PACKAGE_WPA_SUPPLICANT=y
BR2_PACKAGE_WPA_SUPPLICANT_EAP=y
BR2_PACKAGE_WPA_SUPPLICANT_CLI=y
BR2_PACKAGE_WPA_SUPPLICANT_PASSPHRASE=y
BR2_PACKAGE_WPA_SUPPLICANT_AP_SUPPORT=y
BR2_PACKAGE_WPA_SUPPLICANT_WPS=y
BR2_PACKAGE_KMOD=y
BR2_PACKAGE_KMOD_TOOLS=y
BR2_PACKAGE_A20_OLINUXINO_SOFTWARE=n
BR2_PACKAGE_A20_OLINUXINO_SOFTWARE_MOD_RTC=n
BR2_TARGET_UBOOT_SUNXI=y
BR2_TARGET_UBOOT_SUNXI_BOARDNAME="A20-OLinuXino_MICRO"
BR2_TARGET_UBOOT_SUNXI_GITHUB_LOCATION="https://github.com/linux-sunxi/u-boot-sunxi/archive"
BR2_TARGET_UBOOT_SUNXI_GITHUB_TAG="v2013.10-sunxi"
BR2_TARGET_UBOOT_SUNXI_FORMAT_IMG=y
BR2_TARGET_UBOOT_SUNXI_SPL=y
BR2_LINUX_KERNEL=y
BR2_LINUX_KERNEL_CUSTOM_GIT=y
BR2_LINUX_KERNEL_CUSTOM_REPO_URL="https://github.com/linux-sunxi/linux-sunxi.git"
BR2_LINUX_KERNEL_DEFCONFIG="a13"
BR2_LINUX_KERNEL_INSTALL_TARGET=y
BR2_ARM_CPU_HAS_NEON=y
BR2_ARM_FPU_NEON=y
BR2_ARM_EABIHF=y
BR2_GCC_TARGET_FLOAT_ABI="hard"
BR2_GCC_TARGET_ABI="aapcs-linux"
BR2_TOOLCHAIN_USES_GLIBC=y
BR2_TOOLCHAIN_EXTERNAL=y
BR2_TOOLCHAIN_EXTERNAL_CUSTOM=y
BR2_TOOLCHAIN_EXTERNAL_PREINSTALLED=y
BR2_TOOLCHAIN_EXTERNAL_CUSTOM_PREFIX="$(ARCH)-cortex_a7-linux-gnueabi"
BR2_TOOLCHAIN_EXTERNAL_PREFIX="$(ARCH)-cortex_a7-linux-gnueabi"
BR2_TOOLCHAIN_EXTERNAL_GLIBC=y
BR2_TOOLCHAIN_EXTERNAL_CUSTOM_GLIBC=y
BR2_TOOLCHAIN_EXTERNAL_GCC_5=y
BR2_TOOLCHAIN_EXTERNAL_HEADERS_3_4=y
BR2_TOOLCHAIN_EXTERNAL_CXX=y
BR2_TOOLCHAIN_EXTRA_EXTERNAL_LIBS=""
BR2_LINUX_KERNEL_CUSTOM_REPO_VERSION="HEAD"
BR2_LINUX_KERNEL_VERSION="HEAD"
BR2_LINUX_KERNEL_PATCH=""
BR2_LINUX_KERNEL_USE_DEFCONFIG=y

# Qt 5
BR2_PACKAGE_SUNXI_CEDARX=y
BR2_PACKAGE_SUNXI_MALI=y
BR2_PACKAGE_QT5=y
BR2_PACKAGE_QT5BASE=y
BR2_PACKAGE_QT5BASE_LICENSE_APPROVED=y
BR2_PACKAGE_QT5BASE_NETWORK=y
BR2_PACKAGE_QT5BASE_CONCURRENT=y
BR2_PACKAGE_QT5BASE_SQL=y
BR2_PACKAGE_QT5BASE_SQLITE_QT=y
BR2_PACKAGE_QT5BASE_XML=y
BR2_PACKAGE_QT5BASE_GUI=y
BR2_PACKAGE_QT5BASE_WIDGETS=y
BR2_PACKAGE_QT5BASE_TSLIB=y
BR2_PACKAGE_QT5BASE_EGLFS=y
BR2_PACKAGE_QT5BASE_FONTCONFIG=y
BR2_PACKAGE_QT5BASE_GIF=y
BR2_PACKAGE_QT5BASE_JPEG=y
BR2_PACKAGE_QT5BASE_PNG=y
BR2_PACKAGE_QT5BASE_DBUS=y
BR2_PACKAGE_QT5DECLARATIVE=y
BR2_PACKAGE_QT5GRAPHICALEFFECTS=y
BR2_PACKAGE_QT5XMLPATTERNS=y
BR2_PACKAGE_LIBERATION=y
BR2_PACKAGE_LIBERATION_MONO=y
BR2_PACKAGE_LIBERATION_SANS=y
BR2_PACKAGE_LIBERATION_SERIF=y
BR2_TOOLCHAIN_EXTERNAL_PATH="/home/mirec/Documents/Praca/cpp/monoboard/crosstool/x-tools/arm-cortex_a7-linux-gnueabi"
```

## package/a13-olinuxino-software/Config.in
```kconfig
menu "A13 OLinuXino software"

config BR2_PACKAGE_A13_OLINUXINO_SOFTWARE
    bool "A13-OLinuXino software"

if BR2_PACKAGE_A13_OLINUXINO_SOFTWARE
    
config BR2_PACKAGE_A13_OLINUXINO_SOFTWARE_MOD_RTC
    bool "mod-rtc"
    help
      Program to work with MOD-RTC with UEXT connector.

config BR2_PACKAGE_A13_OLINUXINO_SOFTWARE_MOD_TC_MK2
    bool "mod-tc-mk2"
    help
      Program to work with MOD-TC-MK2 with UEXT connector.
      
endif

endmenu
```

## package/a20-olinuxino-software/Config.in
```kconfig
menu "A20 OLinuXino software"

config BR2_PACKAGE_A20_OLINUXINO_SOFTWARE
    bool "A20-OLinuXino software"

if BR2_PACKAGE_A20_OLINUXINO_SOFTWARE
    
config BR2_PACKAGE_A20_OLINUXINO_SOFTWARE_MOD_RTC
    bool "mod-rtc"
    help
      Program to work with MOD-RTC with UEXT connector.
      
endif

endmenu
```

## package/mali400/Config.in
```kconfig
config BR2_PACKAGE_MALI400
	bool "mali400"
	depends on BR2_arm
	depends on BR2_INSTALL_LIBSTDCPP
	depends on BR2_LARGEFILE
	select BR2_PACKAGE_HAS_OPENGL_EGL
	select BR2_PACKAGE_HAS_OPENGL_ES
	select BR2_PACKAGE_HAS_OPENVG
	select BR2_PACKAGE_HAS_OPENMAX
	help
	  Mali400 display drivers.

	  Includes source for the ARM side code to interface to:
	  EGL, mmal, GLESv2, vcos, openmaxil, vchiq_arm, bcm_host, WFC, OpenVG.

	  https://github.com/linux-sunxi/sunxi-mali

comment "mali400 requires a toolchain with C++ and LARGEFILE support"
	depends on !BR2_INSTALL_LIBSTDCPP || !BR2_LARGEFILE
```

## package/nginx/Config.in
```kconfig
config BR2_PACKAGE_NGINX
	bool "nginx"
	help
	  nginx [engine x] is an HTTP and reverse proxy server, as well as a mail
	  proxy server, written by Igor Sysoev

	  http://nginx.org


if BR2_PACKAGE_NGINX



endif
```

## package/picolisp/Config.in
```kconfig
config BR2_PACKAGE_PICOLISP
    bool "picolisp"
	depends on BR2_LARGEFILE
	depends on BR2_INET_IPV6
    help
      Picolisp is "Scalpel of Programming": Sharp, accurate, small and
      lightweight, but also dangerous in the hand of the
      inexperienced.

      http://picolisp.com/

comment "picolisp requires a toolchain with LARGEFILE, IPV6"
	depends on !BR2_LARGEFILE || !BR2_INET_IPV6
```

## package/python-reportlab/Config.in
```kconfig
config BR2_PACKAGE_PYTHON_REPORTLAB
	bool "python-reportlab"
	select BR2_PACKAGE_DISTRIBUTE
	select BR2_PACKAGE_ZLIB
	select BR2_PACKAGE_FREETYPE
	select BR2_PACKAGE_JPEG_LIBRARY
	help
	  The ReportLab Toolkit. An Open Source Python library for generating PDFs and graphics.

	  https://pypi.python.org/pypi/reportlab
```

## package/qt5/libconnman-qt/Config.in
```kconfig
config BR2_PACKAGE_LIBCONNMAN_QT
	bool "libconnman-qt"
	select BR2_PACKAGE_QT5BASE
	depends on BR2_PACKAGE_CONNMAN
	help
	  The Qt bindings are direct reflection of ConnMan's D-Bus interfaces

	  https://github.com/nemomobile/libconnman-qt
```

## package/uwsgi/Config.in
```kconfig
config BR2_PACKAGE_UWSGI
	bool "uwsgi"
	help
	  The uWSGI project aims at developing a full stack for building hosting
	  services.

	  http://projects.unbit.it/uwsgi/


if BR2_PACKAGE_UWSGI



endif
```
